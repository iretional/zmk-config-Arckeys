/*
 * Copyright (c) 2021 The ZMK Contributors
 *
 * SPDX-License-Identifier: MIT
 */

/dts-v1/;
#include "arckeys.dtsi"

/ {
    chosen {
        zmk,battery = &vbatt;
    };
    
    vbatt: vbatt {
        compatible = "zmk,battery-nrf-vddh";
    };
};
