/*
*
* Copyright (c) 2023 The ZMK Contributors
* SPDX-License-Identifier: MIT
*
*/

#include "arckeys.dtsi"

/{
    kscan0: kscan {
        compatible = "zmk,kscan-gpio-matrix";

        diode-direction = "col2row";
        row-gpios
            = <&gpio1 10 GPIO_ACTIVE_HIGH>  // RW 1 [keynapse] - R0
            , <&gpio1 6 GPIO_ACTIVE_HIGH>   // RW 2 [keynapse]
            , <&gpio1 4 GPIO_ACTIVE_HIGH>   // RW 3 [keynapse]
            , <&gpio1 11 GPIO_ACTIVE_HIGH>  // RW 4 [keynapse]
            , <&gpio1 12 GPIO_ACTIVE_HIGH>  // RW 5 [keynapse]
            , <&gpio1 13 GPIO_ACTIVE_HIGH>  // RW 6 [keynapse]
            , <&gpio1 14 GPIO_ACTIVE_HIGH>  // RW 7 [keynapse] - R6
            ;

        col-gpios
            = <&gpio0 28 (GPIO_ACTIVE_HIGH | GPIO_PULL_DOWN)>   // CL 6 [keynapse] - C0
            , <&gpio0 31 (GPIO_ACTIVE_HIGH | GPIO_PULL_DOWN)>
            , <&gpio0 2 (GPIO_ACTIVE_HIGH | GPIO_PULL_DOWN)>
            , <&gpio0 29 (GPIO_ACTIVE_HIGH | GPIO_PULL_DOWN)>
            , <&gpio0 3 (GPIO_ACTIVE_HIGH | GPIO_PULL_DOWN)>
            , <&gpio1 15 (GPIO_ACTIVE_HIGH | GPIO_PULL_DOWN)>   // CL 1 [keynapse] - C6
            ;
    };
};

&default_transform {
    col-offset = <6>;
};
