/*
*
* Copyright (c) 2025 Ireh Choi
* SPDX-License-Identifier: MIT
*
*/

#include "split_heart.dtsi"

/{
    chosen {
    };

    kscan0: kscan {
        compatible = "zmk,kscan-gpio-matrix";

        diode-direction = "col2row";
        
        row-gpios
            = <&gpio1 10 (GPIO_ACTIVE_HIGH | GPIO_PULL_DOWN)> // RW 1 (top row)
            , <&gpio1  6 (GPIO_ACTIVE_HIGH | GPIO_PULL_DOWN)> // RW 2
            , <&gpio1  4 (GPIO_ACTIVE_HIGH | GPIO_PULL_DOWN)> // RW 3
            , <&gpio1 11 (GPIO_ACTIVE_HIGH | GPIO_PULL_DOWN)> // RW 4 
            , <&gpio1 12 (GPIO_ACTIVE_HIGH | GPIO_PULL_DOWN)> // RW 5 (bottom row)
            , <&gpio1 13 (GPIO_ACTIVE_HIGH | GPIO_PULL_DOWN)> // RW 6 (thumb cluster)
            ;

        col-gpios
            = <&gpio1 15 GPIO_ACTIVE_HIGH> // Col 1  (most left)
            , <&gpio0  3 GPIO_ACTIVE_HIGH> // Col 2 
            , <&gpio0 29 GPIO_ACTIVE_HIGH> // Col 3
            , <&gpio0  2 GPIO_ACTIVE_HIGH> // Col 4 
            , <&gpio0 31 GPIO_ACTIVE_HIGH> // Col 5
            , <&gpio0 28 GPIO_ACTIVE_HIGH> // Col 6  (most right)
            ;
            
    };
};

&default_transform {
    col-offset = <6>;
};
