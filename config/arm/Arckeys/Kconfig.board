## config/arm/Arckeys/Kconfig.board
```kconfig
#
# Copyright (c) 2024 Ireh Choi
# SPDX-License-Identifier: MIT
#

config BOARD_ARCKEYS_LEFT
    bool "arckeys left"
	depends on SOC_NRF52840

config BOARD_ARCKEYS_RIGHT
    bool "arckeys right"
	depends on SOC_NRF52840
```

## config/arm/Arckeys/Kconfig.defconfig
```kconfig
#
# Copyright (c) 2024 Ireh Choi
# SPDX-License-Identifier: MIT
#

if BOARD_ARKEYS_LEFT

config ZMK_KEYBOARD_NAME
    default "arckeys"

config ZMK_SPLIT_ROLE_CENTRAL
    default y

endif # BOARD_ARCKEYS_LEFT


if BOARD_ARCKEYS_LEFT || BOARD_ARCKEYS_RIGHT

config BOARD
    default "arckeys"

config ZMK_SPLIT
    default y

config BT_CTLR
    default BT


endif # BOARD_ARCKEYS_LEFT || BOARD_ARCKEYS_RIGHT
```

## config/boards/arm/Arckeys/Kconfig.board
```kconfig
#
# Copyright (c) 2023 The ZMK Contributors
# SPDX-License-Identifier: MIT
#

config BOARD_ARCKEYS_LEFT
    bool "arckeys_left"
    depends on SOC_NRF52840_QIAA

config BOARD_ARCKEYS_RIGHT
    bool "arckeys_right"
    depends on SOC_NRF52840_QIAA
```

## config/boards/arm/Arckeys/Kconfig.defconfig
```kconfig
#
# Copyright (c) 2023 The ZMK Contributors
# SPDX-License-Identifier: MIT
#

if BOARD_ARCKEYS_LEFT

config ZMK_KEYBOARD_NAME
    default "arckeys"

config ZMK_SPLIT_ROLE_CENTRAL
    default y

endif # BOARD_ARCKEYS_LEFT

if BOARD_ARCKEYS_RIGHT

config ZMK_KEYBOARD_NAME
    default "arckeys right"

endif # BOARD_ARCKEYS_RIGHT


if BOARD_ARCKEYS_LEFT || BOARD_ARCKEYS_RIGHT

config BOARD
    default "arckeys"

config ZMK_SPLIT
    default y

config BT_CTLR
    default BT

if USB

config USB_NRFX
    default y

config USB_DEVICE_STACK
    default y

endif # USB

endif # BOARD_ARCKEYS_LEFT || BOARD_ARCKEYS_RIGHT
```

## config/boards/arm/Arckeys/arckeys_right_defconfig
```kconfig
#
# Copyright (c) 2024 Ireh Choi
# SPDX-License-Identifier: MIT
#

CONFIG_SOC_SERIES_NRF52X=y
CONFIG_SOC_NRF52840_QIAA=y
CONFIG_BOARD_ARCKEYS_RIGHT=y
CONFIG_ZMK_SLEEP=n

# enable pinctrl
CONFIG_PINCTRL=y

# enable GPIO
CONFIG_GPIO=y

# Enable external 32kHz crystal
CONFIG_CLOCK_CONTROL_NRF_K32SRC_XTAL=y
CONFIG_CLOCK_CONTROL_NRF_K32SRC_30PPM=y

# USB/BLE
CONFIG_ZMK_USB=y
CONFIG_ZMK_BLE=y
CONFIG_BT_CTLR=y
CONFIG_NFCT_PINS_AS_GPIOS=y

# BLE 페어링·설정 보존(권장)
CONFIG_FLASH=y
CONFIG_FLASH_PAGE_LAYOUT=y
CONFIG_FLASH_MAP=y
CONFIG_NVS=y
CONFIG_SETTINGS=y
CONFIG_SETTINGS_NVS=y
```

## config/boards/arm/_old/Kconfig.defconfig
```kconfig
# Copyright (c) 2021 The ZMK Contributors
# SPDX-License-Identifier: MIT

if BOARD_ARCKEYS

config BOARD
    default "arckeys"

if USB_DEVICE_STACK

config USB_NRFX
    default y

endif # USB_DEVICE_STACK

config BT_CTLR
    default BT

endif # BOARD_ARCKEYS
```

## config/boards/arm/arckeys/Kconfig
```kconfig
#
# Copyright (c) 2022 The ZMK Contributors
# SPDX-License-Identifier: MIT
#

config BOARD_ARCKEYS_LEFT
    bool

config BOARD_ARCKEYS_RIGHT
    bool
```

## config/boards/arm/arckeys/Kconfig.board
```kconfig
#
# Copyright (c) 2022 Darryl deHaan
# SPDX-License-Identifier: MIT
#


config BOARD_ARCKEYS_LEFT
    bool "arckeys left"
    depends on SOC_NRF52840_QIAA
    select BOARD_ARCKEYS_LEFT

config BOARD_ARCKEYS_RIGHT
    bool "arckeys right"
    depends on SOC_NRF52840_QIAA
    select BOARD_ARCKEYS_RIGHT
```

## config/boards/arm/arckeys/Kconfig.defconfig
```kconfig
#
# Copyright (c) 2022 Darryl deHaan
# SPDX-License-Identifier: MIT
#

if BOARD_ARCKEYS_LEFT

config ZMK_KEYBOARD_NAME
    default "Arckeys"

config ZMK_SPLIT_ROLE_CENTRAL
    default y

endif # BOARD_ARCKEYS_LEFT


if BOARD_ARCKEYS_LEFT || BOARD_ARCKEYS_RIGHT

config BOARD
    default "arckeys"

config ZMK_SPLIT
    default y

config BT_CTLR
    default BT

if USB

config USB_NRFX
    default y

config USB_DEVICE_STACK
    default y

endif # USB


endif # BOARD_ARCKEYS_LEFT || BOARD_ARCKEYS_RIGHT
```

## config/boards/arm/arckeys/arckeys_left_defconfig
```kconfig
#
# Copyright (c) 2025 Ireh Choi
# SPDX-License-Identifier: MIT
#
CONFIG_SOC_SERIES_NRF52X=y
CONFIG_SOC_NRF52840_QIAA=y
CONFIG_BOARD_ARCKEYS_LEFT=y
CONFIG_ZMK_SLEEP=y
CONFIG_ZMK_USB=y
CONFIG_ZMK_BLE=y

# Enable MPU
CONFIG_ARM_MPU=y

# enable pinctrl
CONFIG_PINCTRL=y

# enable GPIO
CONFIG_GPIO=y

CONFIG_NFCT_PINS_AS_GPIOS=y

# Disable 32kHz crystal
CONFIG_BOARD_ENABLE_DCDC=y       # REG0: LDO 모드
CONFIG_BOARD_ENABLE_DCDC_HV=n    # REG1: LDO 모드

# LFCLK를 외부 XTAL 대신 RC로 사용
CONFIG_CLOCK_CONTROL_NRF_K32SRC_XTAL=n
CONFIG_CLOCK_CONTROL_NRF_K32SRC_RC=y
CONFIG_CLOCK_CONTROL_NRF_K32SRC_RC_CALIBRATION=y   # 권장: 온도/주기 보정

# Enable writing to flash
CONFIG_USE_DT_CODE_PARTITION=y
CONFIG_BUILD_OUTPUT_UF2=y
CONFIG_MPU_ALLOW_FLASH_WRITE=y
CONFIG_NVS=y
CONFIG_SETTINGS_NVS=y
CONFIG_FLASH=y
CONFIG_FLASH_PAGE_LAYOUT=y
CONFIG_FLASH_MAP=y

# 주변장치 끄기
CONFIG_SERIAL=n
CONFIG_I2C=n
CONFIG_SPI=n
```

## config/boards/arm/split_heart/Kconfig
```kconfig
config BOARD_SPLIT_HEART_LEFT
       bool
   
config BOARD_SPLIT_HEART_RIGHT
       bool
```

## config/boards/arm/split_heart/Kconfig.board
```kconfig
#
# Copyright (c) 2025 Ireh Choi
# SPDX-License-Identifier: MIT
#

config BOARD_SPLIT_HEART_LEFT
    bool "split heart left"
    depends on SOC_NRF52840_QIAA

config BOARD_SPLIT_HEART_RIGHT
    bool "split heart right"
    depends on SOC_NRF52840_QIAA
```

## config/boards/arm/split_heart/Kconfig.defconfig
```kconfig
#
# Copyright (c) 2025 Ireh Choi
# SPDX-License-Identifier: MIT
#

if BOARD_SPLIT_HEART_LEFT

config ZMK_KEYBOARD_NAME
    default "Split Heart"

config ZMK_SPLIT_ROLE_CENTRAL
    default y

endif # BOARD_SPLIT_HEART_LEFT


if BOARD_SPLIT_HEART_LEFT || BOARD_SPLIT_HEART_RIGHT

config BOARD
    default "split_heart"

config ZMK_SPLIT
    default y

config BT_CTLR
    default BT

if USB

config USB_NRFX
    default y

config USB_DEVICE_STACK
    default y

endif # USB

endif # BOARD_SPLIT_HEART_LEFT || BOARD_SPLIT_HEART_RIGHT
```

## config/boards/arm/split_heart/split_heart_right_defconfig
```kconfig
#
# Copyright (c) 2025 Ireh Choi
# SPDX-License-Identifier: MIT
#
CONFIG_SOC_SERIES_NRF52X=y
CONFIG_SOC_NRF52840_QIAA=y
CONFIG_BOARD_SPLIT_HEART_RIGHT=y
CONFIG_ZMK_SLEEP=n

# Disable 32kHz crystal
CONFIG_BOARD_ENABLE_DCDC=y
CONFIG_BOARD_ENABLE_DCDC_HV=n

# LFCLK를 외부 XTAL 대신 RC로 사용
CONFIG_CLOCK_CONTROL_NRF_K32SRC_XTAL=n
CONFIG_CLOCK_CONTROL_NRF_K32SRC_RC=y

# Enable external 32kHz crystal
# CONFIG_CLOCK_CONTROL_NRF_K32SRC_XTAL=y
# CONFIG_CLOCK_CONTROL_NRF_K32SRC_30PPM=y

# enable pinctrl
CONFIG_PINCTRL=y

# enable GPIO
CONFIG_GPIO=y

# Enable writing to flash
CONFIG_USE_DT_CODE_PARTITION=y
CONFIG_BUILD_OUTPUT_UF2=y
CONFIG_NVS=y
CONFIG_SETTINGS_NVS=y
CONFIG_FLASH=y
CONFIG_FLASH_PAGE_LAYOUT=y
CONFIG_FLASH_MAP=y

CONFIG_ZMK_USB=y
CONFIG_ZMK_BLE=y
CONFIG_NFCT_PINS_AS_GPIOS=y
```
